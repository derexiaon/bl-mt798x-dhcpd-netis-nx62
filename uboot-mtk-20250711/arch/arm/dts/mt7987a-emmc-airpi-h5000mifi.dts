// SPDX-License-Identifier: (GPL-2.0 OR MIT)

/dts-v1/;
#include "mt7987a-emmc-airpi-h5000m.dtsi"

/ {
	model = "MediaTek MT7987 EMMC airpi H5000MIFI";
	compatible = "mediatek,mt7987", "mediatek,mt7987-emmc-rfb",
			"mediatek,mt7987a";
};
